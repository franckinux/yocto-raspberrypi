## build/conf/bblayers.conf
```bitbake
# POKY_BBLAYERS_CONF_VERSION is increased each time build/conf/bblayers.conf
# changes incompatibly
POKY_BBLAYERS_CONF_VERSION = "2"

BBPATH = "${TOPDIR}"
BBFILES ?= ""

BBLAYERS ?= " \
  /home/franck/Documents/yocto/poky/meta \
  /home/franck/Documents/yocto/poky/meta-poky \
  /home/franck/Documents/yocto/poky/meta-yocto-bsp \
  /home/franck/Documents/yocto/meta-raspberrypi \
  /home/franck/Documents/yocto/meta-openembedded/meta-oe \
  /home/franck/Documents/yocto/meta-domotic \
  /home/franck/Documents/yocto/meta-openembedded/meta-networking \
  "
```
